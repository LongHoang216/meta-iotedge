## conf/machine/m3ulcb/bblayers.conf
```bitbake
# POKY_BBLAYERS_CONF_VERSION is increased each time build/conf/bblayers.conf
# changes incompatibly
POKY_BBLAYERS_CONF_VERSION = "2"

BBPATH = "${TOPDIR}"
BBFILES ?= ""

BBLAYERS ?= " \
  ${TOPDIR}/../poky/meta \
  ${TOPDIR}/../poky/meta-poky \
  ${TOPDIR}/../poky/meta-yocto-bsp \
  ${TOPDIR}/../meta-renesas/meta-rcar-gen3 \
  ${TOPDIR}/../meta-openembedded/meta-oe \
  ${TOPDIR}/../meta-openembedded/meta-python \
  /home/remote_user/long/m3ulcb/meta-openembedded/meta-filesystems \
  /home/remote_user/long/m3ulcb/meta-openembedded/meta-networking \
  /home/remote_user/long/m3ulcb/meta-rust \
  /home/remote_user/long/m3ulcb/meta-virtualization \
  /home/remote_user/long/m3ulcb/meta-security/meta-tpm \
  /home/remote_user/long/m3ulcb/meta-clang \
  /home/remote_user/long/m3ulcb/meta-iotedge \
  /home/remote_user/long/m3ulcb/meta-docker/meta-rcar-gen3 \
  "
```
